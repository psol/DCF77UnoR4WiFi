/*
 * Writes on the LED Matrix of the Arduino UNO R4 WiFi.
 * Adapted from Clemens Valens (Elektor)
 * https://github.com/ClemensAtElektor/Arduino-UNO-R4/tree/main/R4WiFi_led_matrix
 */

#include <Arduino.h>
#include "R4Display.h"

// First value is the width of a character in columns. This allows for
// easy tight spacing on the display (TTF kind of thing).
const uint8_t font_5x8[] = {
  3, 0b00000000, 0b00000000, 0b00000000, 0b00000000, 0b00000000,  // space
  1, 0b01011111, 0b00000000, 0b00000000, 0b00000000, 0b00000000,  // !
  3, 0b00000011, 0b00000000, 0b00000011, 0b00000000, 0b00000000,  // "
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  4, 0b00001000, 0b00000100, 0b00001000, 0b00000100, 0b00000000,  // ~
};

// Pixel-to-pin translation table.
// A HEX value encodes two pin numbers. The MSB is to be driven LOW,
// the LSB is to be driven HIGH.
// Example: pixel (4,2) contains the value 0x60, meaning that pin 6 must
// be driven low and pin 0 must be driven high to activate the pixel.
// The pin number is an offset to the constant led_matrix_pin_first
// Note that they all appear in pairs, so you could make the table 50%
// smaller at the cost of doing some swapping for odd or even columns.
// (0,0) is upper left corner when the board's USB connector points to the left.
const uint8_t R4LedDisplay::pixel2Pins[ROWS][COLS] = {
  //  0     1     2     3     4     5     6     7     8     9    10     11
  { 0x37, 0x73, 0x47, 0x74, 0x43, 0x34, 0x87, 0x78, 0x83, 0x38, 0x84, 0x48 },  // 0
  { 0x07, 0x70, 0x03, 0x30, 0x04, 0x40, 0x08, 0x80, 0x67, 0x76, 0x63, 0x36 },  // 1
  { 0x64, 0x46, 0x68, 0x86, 0x60, 0x06, 0x57, 0x75, 0x53, 0x35, 0x54, 0x45 },  // 2
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  { 0xa5, 0x5a, 0xa1, 0x1a, 0xa2, 0x2a, 0x97, 0x79, 0x93, 0x39, 0x94, 0x49 },  // 7
};

void R4LedDisplay::begin() {
  for (pin_size_t i = firstPin; i <= lastPin; i++)
    pinMode(i, INPUT);   // all off
}

void R4LedDisplay::resetBuffer() {
  len = 0;
}

unsigned R4LedDisplay::setText(char *st) {
  char *curSt = st;
  resetBuffer();
  while (*curSt != 0) {
    char ch = *curSt; 
    if (ch < ' ' || ch > '~') break;
    ch -= ' ';
    unsigned pos = 6 * (unsigned)ch;
    uint8_t width = font_5x8[pos++];
    for (unsigned i = 0; i < width; i++)
      loadNextColInBuffer(font_5x8[pos++]);
    curSt++;
    if(*curSt != 0)
      loadNextColInBuffer(0b00000000);
  }
  if (offset >= getBufferLen() - COLS) offset = getBufferLen() - COLS;
  return getBufferLen();
}

// Call periodically at desired fps rate.
void R4LedDisplay::showFrame(unsigned offset, unsigned long duration) {
  if (offset + COLS >= len - 1) return;
  for (unsigned i = 0; i < COLS; i++) {
    unsigned col = buffer[i + offset];
    for (unsigned row = 0; row < ROWS; row++) {
      if ((col & 0x01) != 0)
        lightPixel(i, row, duration);
      col >>= 1;
    }
  }
}

void R4LedDisplay::showFrame(unsigned long duration) {
  showFrame(offset, duration);
}

unsigned R4LedDisplay::nextFrame(unsigned long speed, bool pause) {
  if (millis() - (speed / ratio) >= prev) {
    prev = millis();
    ratio = 1000l;   // microseconds to milliseconds
    offset += direction;
    if (offset >= getBufferLen() - COLS) {
      direction = -1;
      if (pause) ratio = 100l;
    }
    if (offset == 0) {
      direction = +1;
      if (pause) ratio = 100l;
    }
  }
  return offset;
}

R4LedDisplay R4DISPLAY;